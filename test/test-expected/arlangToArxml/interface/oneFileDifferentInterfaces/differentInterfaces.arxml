AUTOSAR XML (schema 4-3-0)
package /c
  client server interface MyInterface
  sender receiver interface AnotherICp
  sender receiver interface AnotherI
  client server interface CopiedIExample2
package /c/d
  sender receiver interface IExample1Mod: example-tag=Val
  client server interface IExample2
package /c/d/e
  client server interface CopiedDiffTagAnotherI
package /newPackage
  sender receiver interface newElement
