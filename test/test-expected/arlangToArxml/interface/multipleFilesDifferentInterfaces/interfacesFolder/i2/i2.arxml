AUTOSAR XML (schema 4-3-0)
package /com1/com2
  client server interface csi1_Modified
  sender receiver interface newSRInterface
  client server interface csi2
