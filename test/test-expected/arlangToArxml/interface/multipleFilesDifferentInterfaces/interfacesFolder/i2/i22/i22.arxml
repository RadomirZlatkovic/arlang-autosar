AUTOSAR XML (schema 4-3-0)
package /k
  client server interface ExampleInterface
