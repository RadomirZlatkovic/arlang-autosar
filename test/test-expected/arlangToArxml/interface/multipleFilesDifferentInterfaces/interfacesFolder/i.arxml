AUTOSAR XML (schema 4-3-0)
package /e
  client server interface ReliableConnection: a=b=c=val
  sender receiver interface UnreliableConnection
  sender receiver interface modifiedTagDiagConnection
  client server interface ReliableConnectionCp1: a=b=c=val
  sender receiver interface UnreliableConnectionCp
  client server interface ReliableConnectionCp2: a=b=c=val
package /m
  5 x sender receiver interface:
    n{1..5}
