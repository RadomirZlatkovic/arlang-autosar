AUTOSAR XML (schema 4-3-0)
package /p1
  sender receiver interface temperature_new
package /p1/p2/p3/p4
  sender receiver interface time
package /p2
  sender receiver interface speed_new
