AUTOSAR XML (schema 4-3-0)
package /last
  sender receiver interface SR_I_2
package /last/d
  4 x sender receiver interface:
    SR_1
    SR_I_1_Cp
    SR_I_1Changed
    SR_I_2
