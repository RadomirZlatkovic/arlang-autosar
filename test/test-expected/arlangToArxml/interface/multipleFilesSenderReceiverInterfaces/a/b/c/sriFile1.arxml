AUTOSAR XML (schema 4-3-0)
package /a/b/c
  6 x sender receiver interface:
    NEW
    SR_1_Cp1
    SR_1
    SR_1_Cp2
    SR_I_1
    SR_1_Cp3
