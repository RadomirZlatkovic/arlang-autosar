AUTOSAR XML (schema 4-3-0)
package /collection
  7 x client server interface:
    new{1..3}
    cs1
    new4
    new5
    cs222
package /p1/p2/p3
  client server interface cs2Copied
  client server interface cs1Copied
