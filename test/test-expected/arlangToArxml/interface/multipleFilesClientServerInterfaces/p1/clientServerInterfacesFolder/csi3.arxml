AUTOSAR XML (schema 4-3-0)
package /clientServerInterfacesPackage/p1/a/b
  client server interface CSI3
