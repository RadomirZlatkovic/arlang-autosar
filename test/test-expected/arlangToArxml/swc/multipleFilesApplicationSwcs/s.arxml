AUTOSAR XML (schema 4-3-0)
package /firstPackage/a/b/c
  application sw component type appSwc
  application sw component type sswcCopied
