AUTOSAR XML (schema 4-3-0)
package /s2
  application sw component type LastComponent
  application sw component type LastComponentCp1
  application sw component type LastComponentCp2
package /s2/s22
  application sw component type LastComponentCp3
  application sw component type LastComponentCp4
