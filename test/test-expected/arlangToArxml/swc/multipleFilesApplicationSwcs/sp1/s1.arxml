AUTOSAR XML (schema 4-3-0)
package /p1/p2
  application sw component type firstComponent
package /p1/p2/p3
  application sw component type NewAppSwc1
  application sw component type sswcModified
  application sw component type NewAppSwc2
