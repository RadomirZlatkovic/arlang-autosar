AUTOSAR XML (schema 4-3-0)
package /ComponentsPackage
  application sw component type c1: example-tag1=example-tag2=Value
package /ComponentsPackage/A
  application sw component type Component2
  application sw component type Component3
package /ComponentsPackage/A/b
  application sw component type ab
  application sw component type NewCp{1..3}
  application sw component type Component2Cp
  application sw component type NewCp4
  application sw component type NewCp5
  application sw component type Component3Cp
  application sw component type NewCp6
package /ComponentsPackage/C
  application sw component type swc
package /ComponentsPackageCopy
  application sw component type c1cp{1..3}: example-tag1=example-tag2=Value
