AUTOSAR XML (schema 4-3-0)
package /ComponentsPackage
  application sw component type c1: example-tag1=example-tag2=Value
package /ComponentsPackage/A
  application sw component type Component2
  application sw component type Component3
package /ComponentsPackage/A/b
  application sw component type ab
package /ComponentsPackage/C
  application sw component type swc
