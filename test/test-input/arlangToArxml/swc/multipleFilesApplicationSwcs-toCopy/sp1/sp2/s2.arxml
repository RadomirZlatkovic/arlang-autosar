AUTOSAR XML (schema 4-3-0)
package /s2
  application sw component type LastComponent
