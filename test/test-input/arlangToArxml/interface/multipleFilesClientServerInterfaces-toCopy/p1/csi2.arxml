AUTOSAR XML (schema 4-3-0)
package /a1
  client server interface csi2
