AUTOSAR XML (schema 4-3-0)
package /collection
  client server interface cs1
  client server interface cs2
