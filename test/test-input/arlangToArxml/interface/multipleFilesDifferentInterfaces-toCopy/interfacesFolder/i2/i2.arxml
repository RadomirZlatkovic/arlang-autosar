AUTOSAR XML (schema 4-3-0)
package /com1/com2
  client server interface csi1
  client server interface csi2
