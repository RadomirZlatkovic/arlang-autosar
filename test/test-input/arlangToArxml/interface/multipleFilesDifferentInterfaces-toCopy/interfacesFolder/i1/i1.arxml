AUTOSAR XML (schema 4-3-0)
package /e
  sender receiver interface sri1
  sender receiver interface sri2
