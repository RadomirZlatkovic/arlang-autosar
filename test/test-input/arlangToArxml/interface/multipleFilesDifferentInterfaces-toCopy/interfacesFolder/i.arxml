AUTOSAR XML (schema 4-3-0)
package /e
  client server interface ReliableConnection: a=b=c=val
  sender receiver interface UnreliableConnection
  client server interface DiagConnection
