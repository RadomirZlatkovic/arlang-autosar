AUTOSAR XML (schema 4-3-0)
package /t/package/example
  client server interface Tunnel2
