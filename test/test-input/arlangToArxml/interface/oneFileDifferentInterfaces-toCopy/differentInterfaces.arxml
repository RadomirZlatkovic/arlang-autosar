AUTOSAR XML (schema 4-3-0)
package /c
  client server interface MyInterface
  sender receiver interface AnotherI
package /c/d
  sender receiver interface IExample1: example-tag=Val
  client server interface IExample2
