AUTOSAR XML (schema 4-3-0)
package /last/d
  sender receiver interface SR_1
  sender receiver interface SR_I_1
  sender receiver interface SR_I_2
