AUTOSAR XML (schema 4-3-0)
package /a/b/c
  sender receiver interface SR_1
  sender receiver interface SR_I_1
