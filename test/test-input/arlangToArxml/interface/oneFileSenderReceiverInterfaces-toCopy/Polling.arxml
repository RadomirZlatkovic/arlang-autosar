AUTOSAR XML (schema 4-3-0)
package /p1
  sender receiver interface temperature
package /p2
  sender receiver interface speed
