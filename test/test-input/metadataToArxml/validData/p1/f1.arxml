AUTOSAR XML (schema 4-3-0)
package /SRIP
  sender receiver interface Sri1
  sender receiver interface Sri2
package /SRIP/f
  sender receiver interface Sri3
