AUTOSAR XML (schema 4-3-0)
package /CSIP
  client server interface Csi1
  client server interface Csi2
package /CSIP/f
  client server interface Csi3
