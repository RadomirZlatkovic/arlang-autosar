AUTOSAR XML (schema 4-3-0)
package /p
  client server interface ExampleInterface
