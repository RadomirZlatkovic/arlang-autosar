AUTOSAR XML (schema 4-3-0)
package /j1/j2
  application sw component type j3
