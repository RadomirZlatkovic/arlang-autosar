AUTOSAR XML (schema 4-3-0)
package /s1
  application sw component type ExampleSwcShortName0
package /s1/s2
  application sw component type ExampleSwcShortName{1..3}
