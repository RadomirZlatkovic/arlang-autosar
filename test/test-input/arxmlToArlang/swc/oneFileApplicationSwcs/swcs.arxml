AUTOSAR XML (schema 4-3-0)
package /swcSN0
  application sw component type MySwc0
package /swcSN0/swcSN1/swcSN2
  application sw component type MySwc1
  application sw component type MySwc2
package /j1
  application sw component type MySwc
