AUTOSAR XML (schema 4-3-0)
package /p
  application sw component type SWC1
    provide port MyPort: provided-interface=I1
  application sw component type SWC2
    require port MyPort: required-interface=I1
package /p/pn
  application sw component type SWC3
    provide port ExamplePort: provided-interface=I2
  application sw component type SWC4
    require port ExamplePort: required-interface=I2
