AUTOSAR XML (schema 4-3-0)
package /Interfaces
  client server interface I1
  sender receiver interface I2
