AUTOSAR XML (schema 4-3-0)
package /p1
  sender receiver interface sri
