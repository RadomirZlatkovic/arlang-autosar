AUTOSAR XML (schema 4-3-0)
package /sh1
  sender receiver interface sri0
  sender receiver interface sri1
package /sh2
  sender receiver interface sri2
  sender receiver interface sri3
