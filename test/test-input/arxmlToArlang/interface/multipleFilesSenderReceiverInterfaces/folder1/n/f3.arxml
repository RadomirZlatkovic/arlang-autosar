AUTOSAR XML (schema 4-3-0)
package /n
  sender receiver interface n
