AUTOSAR XML (schema 4-3-0)
package /csiHolder0/csiHolder1/csiHolder2
  client server interface csi0
  client server interface csi1
package /p1
  client server interface csi
