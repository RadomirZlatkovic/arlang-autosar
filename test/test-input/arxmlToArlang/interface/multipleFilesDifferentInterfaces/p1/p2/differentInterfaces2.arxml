AUTOSAR XML (schema 4-3-0)
package /c1
  client server interface ExampleInterface1
  client server interface ExampleInterface2
  sender receiver interface ExampleInterface3
package /c1/CN
  client server interface i
package /c2
  sender receiver interface ExampleInterface1
  sender receiver interface ExampleInterface2
  client server interface ExampleInterface3
package /c2/CN
  sender receiver interface i
