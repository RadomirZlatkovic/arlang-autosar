AUTOSAR XML (schema 4-3-0)
package /SenderReceiverInterfacesPackage
  sender receiver interface Sri1
  sender receiver interface Sri2
package /SenderReceiverInterfacesPackage/f
  sender receiver interface Sri3
