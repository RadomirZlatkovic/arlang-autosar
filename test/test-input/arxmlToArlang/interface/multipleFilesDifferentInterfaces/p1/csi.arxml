AUTOSAR XML (schema 4-3-0)
package /ClientServerInterfacesPackage
  client server interface Csi1
  client server interface Csi2
package /ClientServerInterfacesPackage/f
  client server interface Csi3
