AUTOSAR XML (schema 4-3-0)
package /DifferentInterfaces1Package
  client server interface ExampleInterface1
  client server interface ExampleInterface2
  sender receiver interface ExampleInterface3
  client server interface ExampleInterface4
  sender receiver interface ExampleInterface5
