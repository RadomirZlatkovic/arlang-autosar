AUTOSAR XML (schema 4-3-0)
package /sh1
  client server interface csi0
  client server interface csi1
package /sh2
  client server interface csi2
  client server interface csi3
