AUTOSAR XML (schema 4-3-0)
package /n
  client server interface n
