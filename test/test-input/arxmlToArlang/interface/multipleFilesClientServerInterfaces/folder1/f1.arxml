AUTOSAR XML (schema 4-3-0)
package /p1/p2/p3
  client server interface csi
