AUTOSAR XML (schema 4-3-0)
package /p1
  client server interface csi
