AUTOSAR XML (schema 4-3-0)
package /exampleShortName
  sender receiver interface SRI
package /p1
  sender receiver interface SRI0
package /p1/P2
  sender receiver interface SRI1
  sender receiver interface SRI2
