AUTOSAR XML (schema 4-3-0)
package /i1
  client server interface Interface1
  sender receiver interface Interface2
package /i1/i2
  sender receiver interface Interface1
package /i1/i2/i3
  client server interface Interface2
package /LastPackage
  sender receiver interface i1
  client server interface i2
  sender receiver interface i3
  client server interface i4
